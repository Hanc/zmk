## config/boards/shields/page_turner/Kconfig.shield
```kconfig
# Copyright (c) 2026 The ZMK Contributors
# SPDX-License-Identifier: MIT

config SHIELD_PAGE_TURNER
    def_bool $(shields_list_contains,page_turner)
```
